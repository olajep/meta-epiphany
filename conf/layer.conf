## conf/layer.conf
```bitbake
# We have a conf and classes directory, add to BBPATH
BBPATH := "${BBPATH}:${LAYERDIR}"

# We have a packages directory, add to BBFILES
BBFILES := "${BBFILES} ${LAYERDIR}/recipes-*/*/*.bb"
BBFILES += " ${LAYERDIR}/recipes-*/*/*.bbappend"

BBFILE_COLLECTIONS += "epiphany"
BBFILE_PATTERN_epiphany := "^${LAYERDIR}/"
BBFILE_PRIORITY_epiphany = "8"

LAYERSERIES_COMPAT_epiphany = "kirkstone"

PACKAGE_EXTRA_ARCHS:append = " epiphany"

# Epiphany toolchain options:
EPIPHANY_LIBC ?= "newlib"
TCLIBC:epiphany = "newlib"
DISABLE_STATIC:epiphany = ""
LIBCOVERRIDE:epiphany = ":libc-${EPIPHANY_LIBC}"
# Should be possible to enable these with newer binutils?
LINKER_HASH_STYLE:epiphany = ""
GCCPIE:epiphany = ""
SECURITY_PIE_CFLAGS:epiphany = ""
```
